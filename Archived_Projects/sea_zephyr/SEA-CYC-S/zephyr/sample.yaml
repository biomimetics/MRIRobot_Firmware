## Archived_Projects/sea_zephyr/SEA-CYC-S/zephyr/sample.yaml
```yaml
supported:
  - arduino_gpio
  - arduino_i2c
  - arduino_spi
  - gpio
  - i2c
  - spi
  - watchdog
  - adc
  - dac
  - pwm
  - rng
  - eeprom
sample:
  description: Usage quadrature decoder sensor
  name: qdec_sensor
tests:
  sample.sensor.qdec_sensor:
    tags: sensors
    platform_allow: nucleo_f446re
    timeout: 5
    harness: console
    harness_config:
      type: multi_line
      ordered: true
      regex:
        - "Quadrature decoder sensor test"
        - "Position = (.*) degrees"
      fixture: fixture_mech_encoder
sample:
  description: Usage of STM32 Vbat internal sensor
  name: stm32_vbat_sensor
tests:
  sample.sensor.stm32_vbat_sensor:
    depends_on: adc
    tags: sensors
    platform_allow: nucleo_f446re 
    integration_platforms:
      - nucleo_f446re
    timeout: 10
    harness: console
    harness_config:
      type: multi_line
      ordered: true
      regex:
        - "STM32 Vbat sensor test"
        - "Current Vbat voltage: 3(.*) V"
```
